## qemu86-64-build/conf/bblayers.conf
```bitbake
# POKY_BBLAYERS_CONF_VERSION is increased each time build/conf/bblayers.conf
# changes incompatibly
POKY_BBLAYERS_CONF_VERSION = "2"

BBPATH = "${TOPDIR}"
BBFILES ?= ""

BBLAYERS ?= " \
  /app/oe/sources/poky/meta \
  /app/oe/sources/poky/meta-poky \
  /app/oe/sources/poky/meta-yocto-bsp \
  "
```
